
/* M2b: USB MUSB en modo gadget (peripheral). MAC 0x11200000 + SIF 0x11210000.
 * IRQ GIC_SPI 32 (downstream: GIC_PRIVATE_SIGNALS+32 = hwirq 64). Polaridad
 * LEVEL_LOW como el mmc que ya funciona. Clocks/PHY los gestiona el driver. */
&{/soc} {
	usb0: usb@11200000 {
		compatible = "mediatek,mt6582-musb";
		reg = <0x11200000 0x1000>, <0x11210000 0x1000>;
		reg-names = "mac", "sif";
		interrupts = <GIC_SPI 32 IRQ_TYPE_LEVEL_LOW>;
		dr_mode = "peripheral";
		status = "okay";
	};
};
