/*
 * Snippet DT para el bring-up del CONSYS (WiFi) del MT6582 — MILESTONE 1.
 * Pegar en mt6582-bq-krillin.dts.
 *
 * 1) Anadir los reguladores VCN al nodo `regulators` del PMIC MT6323
 *    (ya existen en el driver mainline mt6323-regulator; solo faltan los nodos DT).
 * 2) Anadir el nodo `consys` que el driver mt6582-consys.c sondea.
 *
 * Fisico: SPM 0x10006000, INFRACFG_AO 0x10001000, CONN_MCU_CONFIG 0x18070000
 * (el driver los mapea por constante; el `reg` aqui es informativo del CONN_MCU_CONFIG).
 * IRQ WiFi HIF = GIC_SPI 164 (WF_HIF_IRQ), CONN_WDT = SPI 163.
 */

/* --- (1) dentro de &mt6323 { regulators { ... } } --- */
mt6323_vcn18_reg: ldo_vcn18 {
	regulator-name = "vcn18";	/* VCN_1V8: digital CONSYS */
	regulator-min-microvolt = <1800000>;
	regulator-max-microvolt = <1800000>;
};

mt6323_vcn28_reg: ldo_vcn28 {
	regulator-name = "vcn28";	/* analog */
	regulator-min-microvolt = <2800000>;
	regulator-max-microvolt = <2800000>;
};

mt6323_vcn33_wifi_reg: ldo_vcn33_wifi {
	regulator-name = "vcn33_wifi";	/* RF WiFi */
	regulator-min-microvolt = <3300000>;
	regulator-max-microvolt = <3300000>;
};

/* --- (2) nodo CONSYS bajo /soc (hermano del resto de periféricos) --- */
consys: consys@18070000 {
	compatible = "mediatek,mt6582-consys";
	reg = <0x18070000 0x1000>;		/* CONN_MCU_CONFIG (chip-id @+0x08) */
	interrupts = <GIC_SPI 164 IRQ_TYPE_LEVEL_LOW>;	/* WF_HIF_IRQ */
	vcn18-supply = <&mt6323_vcn18_reg>;
	vcn28-supply = <&mt6323_vcn28_reg>;
	vcn33-supply = <&mt6323_vcn33_wifi_reg>;
	status = "okay";
};
