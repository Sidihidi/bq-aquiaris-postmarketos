/*
 * Nodo DT del BTIF (transporte serie AP<->CONSYS) — M3a.
 * Pegar en mt6582-bq-krillin.dts dentro de un bloque &{/soc} { ... }.
 * Base física 0x1100C000 (APB), IRQ GIC_SPI 50 (MT_BTIF_IRQ downstream).
 */
&{/soc} {
	btif: btif@1100c000 {
		compatible = "mediatek,mt6582-btif";
		reg = <0x1100c000 0x100>;
		interrupts = <GIC_SPI 50 IRQ_TYPE_LEVEL_LOW>;
		status = "okay";
	};
};
